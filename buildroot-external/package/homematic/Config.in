## buildroot-external/package/homematic/Config.in
```kconfig
config BR2_PACKAGE_HOMEMATIC
	bool "eQ-3 HomeMatic Services"
	help
	  HomeMatic Services by eQ-3
	  
	  http://www.eq-3.de/

if BR2_PACKAGE_HOMEMATIC

choice
	prompt "Architecture"

config BR2_PACKAGE_HOMEMATIC_ARCH_ARM
	bool "arm-gnueabihf"

config BR2_PACKAGE_HOMEMATIC_ARCH_X86_32
	bool "X86_32"
	
endchoice

choice 
	prompt "RF Protocol"

config BR2_PACKAGE_HOMEMATIC_RF_PROTOCOL_HM_ONLY
	bool "HM RF only"
        help
          Support HomeMatic RF Protocol only

config BR2_PACKAGE_HOMEMATAIC_RF_PROTOCOL_HMIP_ONLY
	bool "HmIP RF Only"
        help
          Support HomeMatic IP RF Protocol only

config BR2_PACKAGE_HOMEMATIC_RF_PROTOCOL_HM_HMIP
	bool "HM and HmIP RF"
  help
    Support HomeMatic and Homematic IP RF Protocol

endchoice

choice
	prompt "Wired Protocol"

config BR2_PACKAGE_HOMEMATIC_WIRED_PROTOCOL_HM_ONLY
  bool "HM Wired only"
  help
    Support HomeMatic Wired Protocol only

endchoice

config BR2_PACKAGE_HOMEMATIC_WEBUI
  bool "HomeMatic WebUI"
  help
    HomeMatic WebUI

if BR2_PACKAGE_HOMEMATIC_WEBUI

config BR2_PACKAGE_HOMEMATIC_WEBUI_REGAHSS_BETA
  bool "ReGaHss Beta"
  default "false"
  help
    Install Beta version of ReGaHss

endif

config BR2_PACKAGE_HOMEMATIC_HMSERVER
  bool "HomeMatic HM-Server"
  help
    HomeMatic HM-Server

endif
```

## buildroot-external/package/libxmlparser/Config.in
```kconfig
config BR2_PACKAGE_LIBXMLPARSER
	bool "libxmlparser"
	help
	  XMLParser library

	  https://github.com/eq-3/occu/blob/master/CCU2/download/xmlparser-eQ-3.tar.gz
```

## buildroot-external/package/libxmlrpcxx/Config.in
```kconfig
config BR2_PACKAGE_LIBXMLRPCXX
	bool "libXmlRpc++"
	help
	  Implementation of XmlRpc protocol (libXmlRpc++)

	  https://github.com/eq-3/occu/blob/master/CCU2/download/xmlrpc-eQ-3.tar.gz
```

## buildroot-external/package/multilib32/Config.in
```kconfig
config BR2_PACKAGE_MULTILIB32
	bool "On a 64bit systems this package allows recompile the used toolchain for 32bit systems and stores the created libraries to /lib32,/usr/lib32 accordingly"

config BR2_PACKAGE_MULTILIB32_DEFCONFIG
	string "defconfig filename"
	depends on BR2_PACKAGE_MULTILIB32
```

## buildroot-external/package/multilib32/external/Config.in
```kconfig
menu "eQ-3 HomeMatic Services"
  source "$BR2_EXTERNAL_MULTILIB32_PATH/../../../package/libxmlparser/Config.in"
  source "$BR2_EXTERNAL_MULTILIB32_PATH/../../../package/libxmlrpcxx/Config.in"
endmenu

# External packages
source "$BR2_EXTERNAL_MULTILIB32_PATH/Config.ext.in"
```

## buildroot-external/package/multilib32/external/configs/multilib32_i686_defconfig
```kconfig
BR2_x86_i686=y
BR2_DL_DIR="$(TOPDIR)/../download"
BR2_KERNEL_MIRROR="https://www.kernel.org/pub"
BR2_GNU_MIRROR="http://ftp.gnu.org/pub/gnu"
BR2_CCACHE=y
BR2_OPTIMIZE_2=y
BR2_SSP_STRONG=y
BR2_RELRO_PARTIAL=y
BR2_FORTIFY_SOURCE_1=y
BR2_TOOLCHAIN_BUILDROOT_GLIBC=y
BR2_KERNEL_HEADERS_4_4=y
BR2_TOOLCHAIN_BUILDROOT_CXX=y
BR2_PACKAGE_LIBUSB=y
BR2_PACKAGE_LIBUSB_COMPAT=y
BR2_PACKAGE_LIBZLIB=y
BR2_PACKAGE_READLINE=y
BR2_PACKAGE_NCURSES=y
BR2_PACKAGE_FONTCONFIG=y
BR2_PACKAGE_LIBGLIB2=y
BR2_PACKAGE_OPENSSL=y
BR2_PACKAGE_FILE=y
BR2_PACKAGE_LIBUV=y
BR2_PACKAGE_C_ARES=y
```

## buildroot-external/package/multilib32/external/configs/multilib32_rpi3_defconfig
```kconfig
BR2_arm=y
BR2_cortex_a53=y
BR2_ARM_FPU_NEON_VFPV4=y
BR2_DL_DIR="$(TOPDIR)/../download"
BR2_KERNEL_MIRROR="https://www.kernel.org/pub"
BR2_GNU_MIRROR="http://ftp.gnu.org/pub/gnu"
BR2_OPTIMIZE_2=y
BR2_TOOLCHAIN_BUILDROOT_GLIBC=y
BR2_KERNEL_HEADERS_5_4=y
BR2_TOOLCHAIN_BUILDROOT_CXX=y
BR2_PACKAGE_LIBUSB=y
BR2_PACKAGE_LIBUSB_COMPAT=y
```

## buildroot-external/package/multilib32/external/configs/multilib32_rpi4_defconfig
```kconfig
BR2_arm=y
BR2_cortex_a72=y
BR2_ARM_FPU_NEON_VFPV4=y
BR2_DL_DIR="$(TOPDIR)/../download"
BR2_KERNEL_MIRROR="https://www.kernel.org/pub"
BR2_GNU_MIRROR="http://ftp.gnu.org/pub/gnu"
BR2_OPTIMIZE_2=y
BR2_TOOLCHAIN_BUILDROOT_GLIBC=y
BR2_KERNEL_HEADERS_5_4=y
BR2_TOOLCHAIN_BUILDROOT_CXX=y
BR2_PACKAGE_LIBUSB=y
BR2_PACKAGE_LIBUSB_COMPAT=y
BR2_PACKAGE_LIBZLIB=y
BR2_PACKAGE_READLINE=y
BR2_PACKAGE_NCURSES=y
BR2_PACKAGE_FONTCONFIG=y
BR2_PACKAGE_LIBGLIB2=y
BR2_PACKAGE_LIBOPENSSL=y
```

## buildroot-external/package/neoserver/Config.in
```kconfig
config BR2_PACKAGE_NEOSERVER
	bool "Neo Server"
	help
	  Adds support for mediola Neo Server

	  http://www.mediola.com/
```

## buildroot-external/package/ntp-refclock/Config.in
```kconfig
config BR2_PACKAGE_NTP_REFCLOCK
	bool "ntp-refclock"
	help
	  Wrapper for ntpd reference clock drivers
	  
	  https://github.com/mlichvar/ntp-refclock
```

## buildroot-external/package/occu/Config.in
```kconfig
config BR2_PACKAGE_OCCU
	bool "eQ-3 HomeMatic Services"
	help
	  HomeMatic Services by eQ-3 based on OCCU
	  
	  http://www.eq-3.de/

if BR2_PACKAGE_OCCU

choice
	prompt "Architecture"

config BR2_PACKAGE_OCCU_ARCH_ARM
	bool "arm-gnueabihf"

config BR2_PACKAGE_OCCU_ARCH_X86_32
	bool "X86_32"
	
endchoice

choice 
	prompt "RF Protocol"

config BR2_PACKAGE_OCCU_RF_PROTOCOL_HM_ONLY
	bool "HM RF only"
        help
          Support BidCos-RF Protocol only

config BR2_PACKAGE_OCCU_RF_PROTOCOL_HMIP_ONLY
	bool "HmIP RF Only"
        help
          Support HomeMaticIP-RF Protocol only

config BR2_PACKAGE_OCCU_RF_PROTOCOL_HM_HMIP
	bool "HM and HmIP RF"
  help
    Support BidCos-RF and HomeMaticIP-RF Protocol

endchoice

choice
	prompt "Wired Protocol"

config BR2_PACKAGE_OCCU_WIRED_PROTOCOL_HM_ONLY
  bool "HM Wired only"
  help
    Support HomeMatic Wired Protocol only

endchoice

config BR2_PACKAGE_OCCU_WEBUI
  bool "HomeMatic WebUI"
  help
    HomeMatic WebUI

if BR2_PACKAGE_OCCU_WEBUI

config BR2_PACKAGE_OCCU_WEBUI_REGAHSS_BETA
  bool "ReGaHss Beta"
  default "false"
  help
    Install Beta version of ReGaHss

endif

config BR2_PACKAGE_OCCU_HMSERVER
  bool "HomeMatic HM-/HMIPServer"
  help
    HomeMatic HM-/HMIPServer

endif
```

## buildroot-external/package/picod/Config.in
```kconfig
config BR2_PACKAGE_PICOD
	bool "Pico UPS Daemon Support"
	help
	  Adds support for Pico UPS Support Daemon
    
	  https://github.com/ef-gy/rpi-ups-pico http://pimodules.com
```

## buildroot-external/package/pidesktopd/Config.in
```kconfig
config BR2_PACKAGE_PIDESKTOPD
	bool "PiDesktop HAT Daemon Support"
	help
	  Adds support for PiDesktop Support Daemon

	  https://github.com/hoopsurfer/pidesktop
```

## buildroot-external/package/piusvd/Config.in
```kconfig
config BR2_PACKAGE_PIUSVD
	bool "PiUSV+ UPS Daemon Support"
	help
	  Adds support for PiUSV+ UPS Support Daemon

	  https://www.reichelt.de/?ARTICLE=169883
```

## buildroot-external/package/raspi-fanshim/Config.in
```kconfig
config BR2_PACKAGE_RASPI_FANSHIM
	bool "raspi-fanshim"
	depends on BR2_PACKAGE_WIRINGPI_RPI
	help
	  Lightwight library to control the pimoroni Fan SHIM
	  device on a RaspberryPi

	  https://github.com/flobernd/raspi-fanshim
```

## buildroot-external/package/recovery-image/Config.in
```kconfig
config BR2_PACKAGE_RECOVERY_IMAGE
	bool "Creates a dedicated Recovery image"

config BR2_PACKAGE_RECOVERY_IMAGE_CONFIG
	string "defconfig filename"
	depends on BR2_PACKAGE_RECOVERY_IMAGE
```

## buildroot-external/package/recovery-system/Config.in
```kconfig
config BR2_PACKAGE_RECOVERY_SYSTEM
	bool "Creates a dedicated recovery system and provide it as an initrd"

config BR2_PACKAGE_RECOVERY_SYSTEM_CONFIG
	string "defconfig filename"
	depends on BR2_PACKAGE_RECOVERY_SYSTEM
```

## buildroot-external/package/recovery-system/external/Config.in
```kconfig
source "$BR2_EXTERNAL_RECOVERY_SYSTEM_PATH/../../../package/multilib32/Config.in"

menu "Hardware Support"
  source "$BR2_EXTERNAL_RECOVERY_SYSTEM_PATH/../../../package/intel-e1000e/Config.in"
endmenu

menu "Kernel Module Support"
  source "$BR2_EXTERNAL_RECOVERY_SYSTEM_PATH/../../../package/generic_raw_uart/Config.in"
endmenu

menu "Software Support"
  source "$BR2_EXTERNAL_RECOVERY_SYSTEM_PATH/package/hm-platform/Config.in"
  source "$BR2_EXTERNAL_RECOVERY_SYSTEM_PATH/../../../package/detect_radio_module/Config.in"
  source "$BR2_EXTERNAL_RECOVERY_SYSTEM_PATH/../../../package/wiringpi-rpi/Config.in"
  source "$BR2_EXTERNAL_RECOVERY_SYSTEM_PATH/../../../package/wiringpi-tinker/Config.in"
  source "$BR2_EXTERNAL_RECOVERY_SYSTEM_PATH/../../../package/rndaddtoentcnt/Config.in"
  source "$BR2_EXTERNAL_RECOVERY_SYSTEM_PATH/../../../package/qemu-guest-agent/Config.in"
endmenu

# External packages
source "$BR2_EXTERNAL_RECOVERY_SYSTEM_PATH/Config.ext.in"
```

## buildroot-external/package/recovery-system/external/configs/recovery_ova_defconfig
```kconfig
BR2_x86_64=y
BR2_DL_DIR="$(TOPDIR)/../download"
BR2_KERNEL_MIRROR="https://www.kernel.org/pub"
BR2_GNU_MIRROR="http://ftp.gnu.org/pub/gnu"
BR2_OPTIMIZE_2=y
BR2_GLOBAL_PATCH_DIR="$(BR2_EXTERNAL_EQ3_PATH)/patches"
# BR2_COMPILER_PARANOID_UNSAFE_PATH is not set
BR2_TOOLCHAIN_EXTERNAL=y
BR2_TOOLCHAIN_EXTERNAL_PATH="$(BASE_DIR)/../../../host"
BR2_TOOLCHAIN_EXTERNAL_GCC_9=y
BR2_TOOLCHAIN_EXTERNAL_HEADERS_5_4=y
BR2_KERNEL_HEADERS_5_4=y
BR2_PACKAGE_GLIBC_UTILS=y
BR2_TOOLCHAIN_EXTERNAL_CUSTOM_GLIBC=y
BR2_TOOLCHAIN_EXTERNAL_CXX=y
BR2_ROOTFS_LIB_DIR="lib"
BR2_ROOTFS_LIB32_DIR="lib32"
BR2_TARGET_GENERIC_HOSTNAME="homematic-recovery"
BR2_TARGET_GENERIC_ISSUE="Welcome to CCU Recovery"
BR2_TARGET_GENERIC_PASSWD_SHA512=y
BR2_ROOTFS_DEVICE_CREATION_DYNAMIC_EUDEV=y
# BR2_ENABLE_LOCALE_PURGE is not set
BR2_TARGET_TZ_INFO=y
BR2_TARGET_LOCALTIME="Europe/Berlin"
BR2_ROOTFS_OVERLAY="$(BR2_EXTERNAL_RECOVERY_SYSTEM_PATH)/overlay/base"
BR2_ROOTFS_POST_BUILD_SCRIPT="$(BR2_EXTERNAL_RECOVERY_SYSTEM_PATH)/board/ova/post-build.sh"
BR2_LINUX_KERNEL=y
BR2_LINUX_KERNEL_CUSTOM_VERSION=y
BR2_LINUX_KERNEL_CUSTOM_VERSION_VALUE="5.4.73"
BR2_LINUX_KERNEL_PATCH="$(BR2_EXTERNAL_EQ3_PATH)/board/ova/kernel-patches"
BR2_LINUX_KERNEL_USE_CUSTOM_CONFIG=y
BR2_LINUX_KERNEL_CUSTOM_CONFIG_FILE="$(BR2_EXTERNAL_EQ3_PATH)/board/ova/kernel_defconfig"
BR2_LINUX_KERNEL_LZ4=y
BR2_LINUX_KERNEL_NEEDS_HOST_LIBELF=y
BR2_PACKAGE_LINUX_TOOLS_GPIO=y
BR2_PACKAGE_BUSYBOX_CONFIG="$(BR2_EXTERNAL_EQ3_PATH)/Busybox.config"
BR2_PACKAGE_BUSYBOX_SHOW_OTHERS=y
BR2_PACKAGE_DOSFSTOOLS=y
BR2_PACKAGE_DOSFSTOOLS_FATLABEL=y
BR2_PACKAGE_DOSFSTOOLS_FSCK_FAT=y
BR2_PACKAGE_DOSFSTOOLS_MKFS_FAT=y
BR2_PACKAGE_E2FSPROGS=y
BR2_PACKAGE_E2FSPROGS_E4DEFRAG=y
BR2_PACKAGE_E2FSPROGS_RESIZE2FS=y
BR2_PACKAGE_EXFAT=y
BR2_PACKAGE_EXFAT_UTILS=y
BR2_PACKAGE_F2FS_TOOLS=y
BR2_PACKAGE_NTFS_3G=y
BR2_PACKAGE_PSPLASH=y
BR2_PACKAGE_ACPID=y
BR2_PACKAGE_DMIDECODE=y
BR2_PACKAGE_PARTED=y
BR2_PACKAGE_RNG_TOOLS=y
BR2_PACKAGE_UBOOT_TOOLS=y
BR2_PACKAGE_UBOOT_TOOLS_MKIMAGE=y
BR2_PACKAGE_UBOOT_TOOLS_MKENVIMAGE=y
BR2_PACKAGE_UBOOT_TOOLS_DUMPIMAGE=y
BR2_PACKAGE_USBMOUNT=y
BR2_PACKAGE_CA_CERTIFICATES=y
BR2_PACKAGE_LIBOPENSSL_BIN=y
BR2_PACKAGE_LIBUSB=y
BR2_PACKAGE_LIBUSB_COMPAT=y
BR2_PACKAGE_LIBCURL=y
BR2_PACKAGE_LIBCURL_CURL=y
BR2_PACKAGE_CHRONY=y
BR2_PACKAGE_IFPLUGD=y
BR2_PACKAGE_IPTABLES=y
BR2_PACKAGE_LIGHTTPD=y
BR2_PACKAGE_LIGHTTPD_OPENSSL=y
BR2_PACKAGE_LIGHTTPD_ZLIB=y
BR2_PACKAGE_LIGHTTPD_PCRE=y
BR2_PACKAGE_NTP=y
# BR2_PACKAGE_NTP_NTPD is not set
BR2_PACKAGE_NTP_NTPDATE=y
BR2_PACKAGE_OPENSSH=y
BR2_PACKAGE_RSYNC=y
BR2_PACKAGE_WGET=y
BR2_PACKAGE_WPA_SUPPLICANT=y
BR2_PACKAGE_WPA_SUPPLICANT_AP_SUPPORT=y
BR2_PACKAGE_WPA_SUPPLICANT_EAP=y
BR2_PACKAGE_WPA_SUPPLICANT_HOTSPOT=y
BR2_PACKAGE_WPA_SUPPLICANT_DEBUG_SYSLOG=y
BR2_PACKAGE_WPA_SUPPLICANT_WPS=y
BR2_PACKAGE_WPA_SUPPLICANT_CLI=y
BR2_PACKAGE_WPA_SUPPLICANT_PASSPHRASE=y
BR2_PACKAGE_FILE=y
BR2_PACKAGE_KMOD_TOOLS=y
BR2_PACKAGE_OPENVMTOOLS=y
BR2_PACKAGE_TAR=y
BR2_PACKAGE_UTIL_LINUX_BINARIES=y
BR2_PACKAGE_UTIL_LINUX_LOSETUP=y
BR2_TARGET_ROOTFS_CPIO=y
BR2_TARGET_ROOTFS_CPIO_LZ4=y
# BR2_TARGET_ROOTFS_TAR is not set
BR2_PACKAGE_HOST_DOSFSTOOLS=y
BR2_PACKAGE_HOST_E2FSPROGS=y
BR2_PACKAGE_HOST_GENIMAGE=y
BR2_PACKAGE_HOST_MTOOLS=y
BR2_PACKAGE_MULTILIB32=y
BR2_PACKAGE_MULTILIB32_DEFCONFIG="multilib32_i686_defconfig"
BR2_PACKAGE_GENERIC_RAW_UART=y
BR2_PACKAGE_INTEL_E1000E=y
BR2_PACKAGE_DETECT_RADIO_MODULE=y
BR2_PACKAGE_HM_PLATFORM=y
BR2_PACKAGE_RNDADDTOENTCNT=y
BR2_PACKAGE_QEMU_GUEST_AGENT=y
```

## buildroot-external/package/recovery-system/external/configs/recovery_rpi3_defconfig
```kconfig
BR2_arm=y
BR2_cortex_a7=y
BR2_ARM_FPU_NEON_VFPV4=y
BR2_DL_DIR="$(TOPDIR)/../../../download"
BR2_KERNEL_MIRROR="https://www.kernel.org/pub"
BR2_GNU_MIRROR="http://ftp.gnu.org/pub/gnu"
BR2_OPTIMIZE_2=y
BR2_GLOBAL_PATCH_DIR="$(BR2_EXTERNAL)/patches"
# BR2_COMPILER_PARANOID_UNSAFE_PATH is not set
BR2_TOOLCHAIN_EXTERNAL=y
BR2_TOOLCHAIN_EXTERNAL_CUSTOM=y
BR2_TOOLCHAIN_EXTERNAL_PATH="$(TOPDIR)/../../host"
BR2_TOOLCHAIN_EXTERNAL_GCC_6=y
BR2_TOOLCHAIN_EXTERNAL_HEADERS_4_14=y
BR2_TOOLCHAIN_EXTERNAL_CUSTOM_GLIBC=y
BR2_TOOLCHAIN_EXTERNAL_CXX=y
BR2_TARGET_GENERIC_HOSTNAME="homematic-recovery"
BR2_TARGET_GENERIC_ISSUE="Welcome to CCU Recovery"
BR2_TARGET_GENERIC_PASSWD_SHA512=y
BR2_ROOTFS_DEVICE_CREATION_DYNAMIC_EUDEV=y
# BR2_ENABLE_LOCALE_PURGE is not set
BR2_TARGET_TZ_INFO=y
BR2_TARGET_LOCALTIME="Europe/Berlin"
BR2_ROOTFS_OVERLAY="$(BR2_EXTERNAL)/overlay"
BR2_ROOTFS_POST_BUILD_SCRIPT="$(BR2_EXTERNAL)/board/raspberrypi3/post-build.sh"
BR2_LINUX_KERNEL=y
BR2_LINUX_KERNEL_CUSTOM_TARBALL=y
BR2_LINUX_KERNEL_CUSTOM_TARBALL_LOCATION="https://github.com/raspberrypi/linux/archive/raspberrypi-kernel_1.20180417-1.tar.gz"
BR2_LINUX_KERNEL_USE_CUSTOM_CONFIG=y
BR2_LINUX_KERNEL_CUSTOM_CONFIG_FILE="$(BR2_EXTERNAL)/board/raspberrypi3/kernel_defconfig"
BR2_PACKAGE_BUSYBOX_CONFIG="$(BR2_EXTERNAL)/Busybox.config"
BR2_PACKAGE_BUSYBOX_SHOW_OTHERS=y
BR2_PACKAGE_DOSFSTOOLS=y
BR2_PACKAGE_DOSFSTOOLS_FATLABEL=y
BR2_PACKAGE_DOSFSTOOLS_FSCK_FAT=y
BR2_PACKAGE_DOSFSTOOLS_MKFS_FAT=y
BR2_PACKAGE_E2FSPROGS=y
BR2_PACKAGE_E2FSPROGS_E4DEFRAG=y
BR2_PACKAGE_E2FSPROGS_RESIZE2FS=y
BR2_PACKAGE_NTFS_3G=y
BR2_PACKAGE_PSPLASH=y
BR2_PACKAGE_I2C_TOOLS=y
BR2_PACKAGE_PARTED=y
BR2_PACKAGE_RNG_TOOLS=y
BR2_PACKAGE_RPI_USERLAND=y
BR2_PACKAGE_UBOOT_TOOLS=y
BR2_PACKAGE_UBOOT_TOOLS_MKIMAGE=y
BR2_PACKAGE_UBOOT_TOOLS_MKENVIMAGE=y
BR2_PACKAGE_UBOOT_TOOLS_DUMPIMAGE=y
BR2_PACKAGE_USBMOUNT=y
BR2_PACKAGE_CA_CERTIFICATES=y
BR2_PACKAGE_LIBOPENSSL_BIN=y
BR2_PACKAGE_LIBUSB=y
BR2_PACKAGE_LIBUSB_COMPAT=y
BR2_PACKAGE_WIRINGPI=y
BR2_PACKAGE_LIBCURL=y
BR2_PACKAGE_CURL=y
BR2_PACKAGE_IFPLUGD=y
BR2_PACKAGE_IPTABLES=y
BR2_PACKAGE_LIGHTTPD=y
BR2_PACKAGE_LIGHTTPD_OPENSSL=y
BR2_PACKAGE_LIGHTTPD_ZLIB=y
BR2_PACKAGE_LIGHTTPD_PCRE=y
BR2_PACKAGE_NTP=y
BR2_PACKAGE_NTP_NTPDATE=y
BR2_PACKAGE_NTP_NTPQ=y
BR2_PACKAGE_OPENSSH=y
BR2_PACKAGE_RSYNC=y
BR2_PACKAGE_WGET=y
BR2_PACKAGE_WPA_SUPPLICANT=y
BR2_PACKAGE_WPA_SUPPLICANT_AP_SUPPORT=y
BR2_PACKAGE_WPA_SUPPLICANT_EAP=y
BR2_PACKAGE_WPA_SUPPLICANT_HOTSPOT=y
BR2_PACKAGE_WPA_SUPPLICANT_DEBUG_SYSLOG=y
BR2_PACKAGE_WPA_SUPPLICANT_WPS=y
BR2_PACKAGE_WPA_SUPPLICANT_CLI=y
BR2_PACKAGE_WPA_SUPPLICANT_PASSPHRASE=y
BR2_PACKAGE_FILE=y
BR2_PACKAGE_KMOD_TOOLS=y
BR2_PACKAGE_TAR=y
BR2_PACKAGE_UTIL_LINUX_BINARIES=y
BR2_PACKAGE_UTIL_LINUX_LOSETUP=y
BR2_TARGET_ROOTFS_CPIO=y
BR2_TARGET_ROOTFS_CPIO_GZIP=y
BR2_TARGET_ROOTFS_CPIO_UIMAGE=y
# BR2_TARGET_ROOTFS_TAR is not set
BR2_PACKAGE_HOST_DOSFSTOOLS=y
BR2_PACKAGE_HOST_E2FSPROGS=y
BR2_PACKAGE_HOST_GENIMAGE=y
BR2_PACKAGE_HOST_MTOOLS=y
BR2_PACKAGE_RX8130_RTC=y
```

## buildroot-external/package/recovery-system/external/package/hm-platform/Config.in
```kconfig
config BR2_PACKAGE_HM_PLATFORM
	bool "eQ-3 HomeMatic Services for RecoverySystem"
	help
	  HomeMatic Services by eQ-3 based on OCCU for Recovery System only
	  
	  http://www.eq-3.de/
```

## buildroot-external/package/rndaddtoentcnt/Config.in
```kconfig
config BR2_PACKAGE_RNDADDTOENTCNT
	bool "rndaddtoentcnt"
	help
	  rndaddtoentcnt: A tool to update the entropy count
	  of /dev/urandom in the kernel after having feed in
	  some entropy.
	  
	  https://github.com/jumpnow/rndaddtoentcnt
```
