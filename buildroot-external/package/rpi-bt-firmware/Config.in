## buildroot-external/package/rpi-bt-firmware/Config.in
```kconfig
config BR2_PACKAGE_RPI_BT_FIRMWARE
	bool "rpi-bt-firmware"
	help
	  This package provides the firmware for built
          int bluetooth on the Raspberry Pi 3.
```

## buildroot-external/package/strompi2d/Config.in
```kconfig
config BR2_PACKAGE_STROMPI2D
	bool "StromPi2 UPS Daemon Support"
	help
	  Adds support for StromPi2 UPS Support Daemon

	  https://www.joy-it.net/de/products/RB-StromPi2
```

## buildroot-external/package/susvd/Config.in
```kconfig
config BR2_PACKAGE_SUSVD
	bool "S.USV UPS Daemon Support"
	help
	  Adds support for S.USV UPS Support Daemon

	  http://s-usv.de/
```

## buildroot-external/package/tailscale/Config.in
```kconfig
config BR2_PACKAGE_TAILSCALE
	bool "Tailscale (Zero config wireguard-based VPN"
	help
	  Tailscale Zero config wireguard-based VPN

	  https://tailscale.com/
```

## buildroot-external/package/tclrega/Config.in
```kconfig
config BR2_PACKAGE_TCLREGA
	bool "tclrega"
	help
	  TCL library to interact with ReGaHss

	  https://github.com/eq-3/occu/blob/master/CCU2/download/tclrega-eQ-3.tar.gz
```

## buildroot-external/package/tclrpc/Config.in
```kconfig
config BR2_PACKAGE_TCLRPC
	bool "tclrpc"
	help
	  TCL library to interact with xmlrpc interfaces

	  https://github.com/eq-3/occu/blob/master/CCU2/download/tclrpc-eQ-3.tar.gz
```

## buildroot-external/package/wiringpi-odroid/Config.in
```kconfig
config BR2_PACKAGE_WIRINGPI_ODROID
  bool "wiringpi-odroid"
  depends on BR2_USE_MMU # fork()
  depends on BR2_TOOLCHAIN_HAS_THREADS
  help
    wiringPi libraries (and gpio command) for ODROID

    https://github.com/hardkernel/wiringPi

comment "wiringpi needs a toolchain w/ threads"
  depends on BR2_USE_MMU
  depends on !BR2_TOOLCHAIN_HAS_THREADS
```

## buildroot-external/package/wiringpi-tinker/Config.in
```kconfig
config BR2_PACKAGE_WIRINGPI_TINKER
	bool "wiringpi-tinker"
	depends on BR2_USE_MMU # fork()
	depends on BR2_TOOLCHAIN_HAS_THREADS
	help
	  wiringPi libraries (and gpio command) for ASUS Tinkerboard

	  https://github.com/TinkerBoard/gpio_lib_c

comment "wiringpi needs a toolchain w/ threads"
	depends on BR2_USE_MMU
	depends on !BR2_TOOLCHAIN_HAS_THREADS
```

## buildroot/buildroot-external/Config.in
```kconfig
menu "eQ-3 Homematic Services"
	source "$BR2_EXTERNAL/package/homematic/Config.in"
endmenu

source "$BR2_EXTERNAL/package/java-azul/Config.in"
```

## buildroot/buildroot-external/package/homematic/Config.in
```kconfig
config BR2_PACKAGE_HOMEMATIC
	bool "eQ-3 Homematic Services"
	help
	  Homematic Services by eQ-3
	  
	  http://www.eq-3.de/

if BR2_PACKAGE_HOMEMATIC

config BR2_PACKAGE_HOMEMATIC_RF
        boolean "HomeMatic RF Daemon"
	default "false"
        help
          HomeMatic RF daemon

config BR2_PACKAGE_HOMEMATIC_WIRED
        boolean "HomeMatic Wired Daemon"
	default "false"
        help
          HomeMatic Wired daemon

config BR2_PACKAGE_HOMEMATIC_IP_RF
        boolean "Homematic IP RF Daemon"
	default "false"
        help
          Homematic IP RF daemon

config BR2_PACKAGE_HOMEMATIC_WEBUI
        boolean "HomeMatic WebUI"
	default "false"
        help
          HomeMatic WebUI 

endif
```

## buildroot/buildroot-external/package/java-azul/Config.in
```kconfig
config BR2_PACKAGE_JAVA_AZUL
	bool "Azul Java Runtime"
	help
	  Azul Java Runtim
	  
	  https://www.azul.com/solutions/embedded-and-the-iot/
```
